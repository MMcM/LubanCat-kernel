/dts-v1/;
/plugin/;

#include <dt-bindings/gpio/gpio.h>
#include <dt-bindings/pinctrl/rockchip.h>

/ {

	fragment@0 {
		target = <&pinctrl>;

		__overlay__ {
			gpio1-func {
				gpio1_button_pull_up: gpio1_button_pull_up {
					rockchip,pins =
						/* Keybow Mini */
                                                <1 RK_PA3 RK_FUNC_GPIO &pcfg_pull_up>,
						<1 RK_PA5 RK_FUNC_GPIO &pcfg_pull_up>,
						<1 RK_PB0 RK_FUNC_GPIO &pcfg_pull_up>;
				};
			};
		};
	};

	fragment@1 {
		target = <&gpio1>;

		__overlay__ {
			pinctrl-names = "default";
			pinctrl-0 = <&gpio1_button_pull_up>;
		};
	};

};
